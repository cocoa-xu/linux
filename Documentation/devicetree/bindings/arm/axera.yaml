## Documentation/devicetree/bindings/media/i2c/lontium,lt7911exc.yaml
```yaml
# SPDX-License-Identifier: (GPL-2.0-only OR BSD-2-Clause)
%YAML 1.2
---
$id: http://devicetree.org/schemas/media/i2c/lontium,lt7911exc.yaml#
$schema: http://devicetree.org/meta-schemas/core.yaml#

title: Lontium LT7911EXC USB Type-C/DisplayPort to MIPI CSI-2 bridge

maintainers:
  - Cocoa <i@uwucocoa.moe>

description:
  The LT7911EXC receives DisplayPort (or USB Type-C alternate mode) video
  and sends it as MIPI CSI-2 YUV422 8-bit under control of its own
  firmware. The host reads the detected timings over I2C.

properties:
  compatible:
    const: lontium,lt7911exc

  reg:
    maxItems: 1

  interrupts:
    description: Raised by the firmware when the input appears or disappears.
    maxItems: 1

  reset-gpios:
    maxItems: 1

  port:
    $ref: /schemas/graph.yaml#/$defs/port-base
    unevaluatedProperties: false

    properties:
      endpoint:
        $ref: /schemas/media/video-interfaces.yaml#
        unevaluatedProperties: false

        properties:
          data-lanes:
            items:
              - const: 1
              - const: 2
              - const: 3
              - const: 4

        required:
          - data-lanes

required:
  - compatible
  - reg
  - port

additionalProperties: false

examples:
  - |
    #include <dt-bindings/gpio/gpio.h>
    #include <dt-bindings/interrupt-controller/irq.h>

    i2c {
        #address-cells = <1>;
        #size-cells = <0>;

        video-bridge@41 {
            compatible = "lontium,lt7911exc";
            reg = <0x41>;
            interrupts-extended = <&gpio1 0 IRQ_TYPE_EDGE_FALLING>;
            reset-gpios = <&gpio1 1 GPIO_ACTIVE_LOW>;

            port {
                endpoint {
                    remote-endpoint = <&vin_in>;
                    data-lanes = <1 2 3 4>;
                };
            };
        };
    };
```

## Documentation/devicetree/bindings/misc/sipeed,nanokvm-go-expansion.yaml
```yaml
# SPDX-License-Identifier: (GPL-2.0-only OR BSD-2-Clause)
%YAML 1.2
---
$id: http://devicetree.org/schemas/misc/sipeed,nanokvm-go-expansion.yaml#
$schema: http://devicetree.org/meta-schemas/core.yaml#

title: Sipeed NanoKVM-Go expansion lines

maintainers:
  - Cocoa <i@uwucocoa.moe>

description:
  The two SoC pads that the NanoKVM-Go's auxiliary USB-C port carries, line
  0 and line 1. Each is a UART line, a PWM output or a GPIO depending on its
  pin function, and the two can be a bit-banged I2C bus. Every mode is the
  pin state named after it; "off" leaves both lines as inputs pulled down
  and is the one required.

allOf:
  - $ref: /schemas/pinctrl/pinctrl-consumer.yaml#

properties:
  compatible:
    const: sipeed,nanokvm-go-expansion

  line-gpios:
    description: The lines as GPIOs, line 0 first.
    minItems: 2
    maxItems: 2

  pwms:
    minItems: 2
    maxItems: 2

  pwm-names:
    items:
      - const: line0
      - const: line1

  pinctrl-names:
    minItems: 1
    maxItems: 7
    items:
      enum: ["off", uart, gpio, pwm, pwm-gpio, gpio-pwm, i2c]
    contains:
      const: "off"

  i2c:
    $ref: /schemas/i2c/i2c-gpio.yaml#
    unevaluatedProperties: false
    description:
      The bus of the "i2c" mode, SDA on line 0 and SCL on line 1. It only
      exists while that mode is selected.

required:
  - compatible
  - line-gpios
  - pwms
  - pwm-names
  - pinctrl-names
  - pinctrl-0

unevaluatedProperties: false

examples:
  - |
    #include <dt-bindings/gpio/gpio.h>

    expansion {
        compatible = "sipeed,nanokvm-go-expansion";
        line-gpios = <&gpio1 2 GPIO_ACTIVE_HIGH>, <&gpio1 3 GPIO_ACTIVE_HIGH>;
        pwms = <&pwm1 0 20000000 0>, <&pwm1 1 20000000 0>;
        pwm-names = "line0", "line1";
        pinctrl-names = "off", "uart", "i2c";
        pinctrl-0 = <&expansion_off_pins>;
        pinctrl-1 = <&expansion_uart_pins>;
        pinctrl-2 = <&expansion_i2c_pins>;

        i2c {
            compatible = "i2c-gpio";
            sda-gpios = <&gpio1 2 (GPIO_ACTIVE_HIGH | GPIO_OPEN_DRAIN)>;
            scl-gpios = <&gpio1 3 (GPIO_ACTIVE_HIGH | GPIO_OPEN_DRAIN)>;
            i2c-gpio,delay-us = <10>;
            #address-cells = <1>;
            #size-cells = <0>;
        };
    };
```

## Documentation/devicetree/bindings/npu/axera,ax620e-npu.yaml
```yaml
# SPDX-License-Identifier: (GPL-2.0-only OR BSD-2-Clause)
%YAML 1.2
---
$id: http://devicetree.org/schemas/npu/axera,ax620e-npu.yaml#
$schema: http://devicetree.org/meta-schemas/core.yaml#

title: Axera AX620E NPU

maintainers:
  - Cocoa <i@uwucocoa.moe>

description:
  The neural network accelerator of the Axera AX620E family. Four execution
  units run the command streams of compiled models, which a dispatcher feeds
  from 2.5 MiB of on-chip memory. The NPU has its own clock muxes, gates and
  resets, and splits into two virtual NPUs, each with a task-done and an
  error interrupt. It has no IOMMU, so its buffers must be physically
  contiguous.

properties:
  compatible:
    const: axera,ax620e-npu

  reg:
    items:
      - description:
          Execution units, dispatcher, sync manager, fabric and the global
          clock and reset controls
      - description: On-chip memory

  reg-names:
    items:
      - const: regs
      - const: ocm

  interrupts:
    items:
      - description: Virtual NPU 0 finished a task
      - description: Virtual NPU 1 finished a task
      - description: Virtual NPU 0 error
      - description: Virtual NPU 1 error
      - description: Global

  interrupt-names:
    items:
      - const: normal0
      - const: normal1
      - const: error0
      - const: error1
      - const: top

  memory-region:
    maxItems: 1
    description: Where the NPU's buffers come from.

required:
  - compatible
  - reg
  - reg-names
  - interrupts
  - interrupt-names

additionalProperties: false

examples:
  - |
    #include <dt-bindings/interrupt-controller/arm-gic.h>

    npu@3800000 {
        compatible = "axera,ax620e-npu";
        reg = <0x03800000 0xb0000>, <0x03000000 0x280000>;
        reg-names = "regs", "ocm";
        interrupts = <GIC_SPI 38 IRQ_TYPE_EDGE_RISING>,
                     <GIC_SPI 39 IRQ_TYPE_EDGE_RISING>,
                     <GIC_SPI 42 IRQ_TYPE_EDGE_RISING>,
                     <GIC_SPI 43 IRQ_TYPE_EDGE_RISING>,
                     <GIC_SPI 40 IRQ_TYPE_EDGE_RISING>;
        interrupt-names = "normal0", "normal1", "error0", "error1", "top";
    };
```

## Documentation/devicetree/bindings/nvmem/axera,ax620e-misc-info.yaml
```yaml
# SPDX-License-Identifier: (GPL-2.0-only OR BSD-2-Clause)
%YAML 1.2
---
$id: http://devicetree.org/schemas/nvmem/axera,ax620e-misc-info.yaml#
$schema: http://devicetree.org/meta-schemas/core.yaml#

title: Axera AX620E chip information in IRAM

maintainers:
  - Cocoa <i@uwucocoa.moe>

description: |
  The SPL of Axera AX620E SoCs copies eFuse data to a fixed area of IRAM:
  board and chip type, the unique ID and sensor calibration. Key material
  sits right before these fields, so the node must cover the fields only.

allOf:
  - $ref: nvmem.yaml#

properties:
  compatible:
    const: axera,ax620e-misc-info

  reg:
    maxItems: 1

required:
  - compatible
  - reg

unevaluatedProperties: false

examples:
  - |
    nvmem@780 {
        compatible = "axera,ax620e-misc-info";
        reg = <0x780 0x20>;

        nvmem-layout {
            compatible = "fixed-layout";
            #address-cells = <1>;
            #size-cells = <1>;

            thm-vref@10 {
                reg = <0x10 0x4>;
            };
        };
    };
```

## Documentation/devicetree/bindings/phy/axera,ax620e-usb2-phy.yaml
```yaml
# SPDX-License-Identifier: (GPL-2.0-only OR BSD-2-Clause)
%YAML 1.2
---
$id: http://devicetree.org/schemas/phy/axera,ax620e-usb2-phy.yaml#
$schema: http://devicetree.org/meta-schemas/core.yaml#

title: Axera AX620E USB 2.0 PHY

maintainers:
  - Cocoa <i@uwucocoa.moe>

description:
  UTMI PHY of the DWC3 USB 2.0 controller on Axera AX620E SoCs. Its reset,
  reference clock and the VBUS-valid override live in FLASH_SYS.

properties:
  compatible:
    const: axera,ax620e-usb2-phy

  axera,flash-sys:
    $ref: /schemas/types.yaml#/definitions/phandle
    description: The FLASH_SYS clock and reset controller.

  clocks:
    maxItems: 1

  resets:
    maxItems: 1

  '#phy-cells':
    const: 0

required:
  - compatible
  - axera,flash-sys
  - resets
  - '#phy-cells'

additionalProperties: false

examples:
  - |
    #include <dt-bindings/clock/axera,ax620e-flash-sys.h>
    #include <dt-bindings/reset/axera,ax620e-flash-sys.h>

    usb-phy {
        compatible = "axera,ax620e-usb2-phy";
        axera,flash-sys = <&flash_sys>;
        clocks = <&flash_sys AX620E_FLASH_CLK_USB2_REF_ALT>;
        resets = <&flash_sys AX620E_FLASH_RST_USB2_PHY>;
        #phy-cells = <0>;
    };
```

## Documentation/devicetree/bindings/pwm/axera,ax620e-pwm.yaml
```yaml
# SPDX-License-Identifier: (GPL-2.0-only OR BSD-2-Clause)
%YAML 1.2
---
$id: http://devicetree.org/schemas/pwm/axera,ax620e-pwm.yaml#
$schema: http://devicetree.org/meta-schemas/core.yaml#

title: Axera AX620E PWM controller

maintainers:
  - Cocoa <i@uwucocoa.moe>

description:
  A block of four PWM channels, DesignWare APB timers in PWM mode that
  count the timer clock; AX620E SoCs have three.

allOf:
  - $ref: pwm.yaml#

properties:
  compatible:
    const: axera,ax620e-pwm

  reg:
    maxItems: 1

  clocks:
    items:
      - description: APB bus clock
      - description: Timer clock of channel 0
      - description: Timer clock of channel 1
      - description: Timer clock of channel 2
      - description: Timer clock of channel 3

  clock-names:
    items:
      - const: pclk
      - const: ch0
      - const: ch1
      - const: ch2
      - const: ch3

  resets:
    maxItems: 1

  "#pwm-cells":
    const: 3

required:
  - compatible
  - reg
  - clocks
  - clock-names
  - resets

unevaluatedProperties: false

examples:
  - |
    #include <dt-bindings/clock/axera,ax620e-periph-sys.h>
    #include <dt-bindings/reset/axera,ax620e-periph-sys.h>

    pwm@6061000 {
        compatible = "axera,ax620e-pwm";
        reg = <0x06061000 0x400>;
        clocks = <&periph_sys AX620E_PERIPH_PCLK_PWM1>,
                 <&periph_sys AX620E_PERIPH_CLK_PWM10>,
                 <&periph_sys AX620E_PERIPH_CLK_PWM11>,
                 <&periph_sys AX620E_PERIPH_CLK_PWM12>,
                 <&periph_sys AX620E_PERIPH_CLK_PWM13>;
        clock-names = "pclk", "ch0", "ch1", "ch2", "ch3";
        resets = <&periph_sys AX620E_PERIPH_RST_PWM1>;
        #pwm-cells = <3>;
    };
```

## Documentation/devicetree/bindings/thermal/axera,ax620e-tsensor.yaml
```yaml
# SPDX-License-Identifier: (GPL-2.0-only OR BSD-2-Clause)
%YAML 1.2
---
$id: http://devicetree.org/schemas/thermal/axera,ax620e-tsensor.yaml#
$schema: http://devicetree.org/meta-schemas/core.yaml#

title: Axera AX620E temperature sensor

maintainers:
  - Cocoa <i@uwucocoa.moe>

description:
  The on-die temperature sensor of Axera AX620E SoCs, which shares a
  monitor block with the general purpose ADC.

allOf:
  - $ref: thermal-sensor.yaml#

properties:
  compatible:
    const: axera,ax620e-tsensor

  reg:
    maxItems: 1

  interrupts:
    maxItems: 1

  clocks:
    items:
      - description: APB clock
      - description: Sensor clock

  resets:
    items:
      - description: APB reset
      - description: Sensor reset

  reset-names:
    items:
      - const: apb
      - const: sensor

  nvmem-cells:
    items:
      - description: Reference trim from the eFuses

  nvmem-cell-names:
    items:
      - const: vref

  '#thermal-sensor-cells':
    const: 0

required:
  - compatible
  - reg
  - clocks
  - resets
  - reset-names

unevaluatedProperties: false

examples:
  - |
    #include <dt-bindings/clock/axera,ax620e-comm-glb.h>
    #include <dt-bindings/interrupt-controller/arm-gic.h>
    #include <dt-bindings/reset/axera,ax620e-comm-glb.h>

    temperature-sensor@2000000 {
        compatible = "axera,ax620e-tsensor";
        reg = <0x02000000 0x1000>;
        interrupts = <GIC_SPI 61 IRQ_TYPE_LEVEL_HIGH>;
        clocks = <&comm_glb AX620E_COMM_PCLK_THM>,
                 <&comm_glb AX620E_COMM_CLK_THM>;
        resets = <&comm_glb AX620E_COMM_RST_THM_APB>,
                 <&comm_glb AX620E_COMM_RST_THM>;
        reset-names = "apb", "sensor";
        nvmem-cells = <&thm_vref>;
        nvmem-cell-names = "vref";
        #thermal-sensor-cells = <0>;
    };
```

## Documentation/devicetree/bindings/watchdog/axera,ax620e-wdt.yaml
```yaml
# SPDX-License-Identifier: (GPL-2.0-only OR BSD-2-Clause)
%YAML 1.2
---
$id: http://devicetree.org/schemas/watchdog/axera,ax620e-wdt.yaml#
$schema: http://devicetree.org/meta-schemas/core.yaml#

title: Axera AX620E watchdog

maintainers:
  - Cocoa <i@uwucocoa.moe>

allOf:
  - $ref: watchdog.yaml#

properties:
  compatible:
    const: axera,ax620e-wdt

  reg:
    maxItems: 1

  interrupts:
    maxItems: 1

  clocks:
    items:
      - description: APB clock
      - description: Counter clock

  clock-names:
    items:
      - const: pclk
      - const: wdt

  resets:
    maxItems: 1

required:
  - compatible
  - reg
  - clocks
  - clock-names

unevaluatedProperties: false

examples:
  - |
    #include <dt-bindings/clock/axera,ax620e-periph-sys.h>
    #include <dt-bindings/interrupt-controller/arm-gic.h>
    #include <dt-bindings/reset/axera,ax620e-periph-sys.h>

    watchdog@4840000 {
        compatible = "axera,ax620e-wdt";
        reg = <0x04840000 0x400>;
        interrupts = <GIC_SPI 149 IRQ_TYPE_LEVEL_HIGH>;
        clocks = <&periph_sys AX620E_PERIPH_PCLK_WDT0>,
                 <&periph_sys AX620E_PERIPH_CLK_WDT0>;
        clock-names = "pclk", "wdt";
        resets = <&periph_sys AX620E_PERIPH_RST_WDT0>;
    };
```

## arch/arm/mach-axera/Kconfig
```kconfig
# SPDX-License-Identifier: GPL-2.0-only
menuconfig ARCH_AXERA
	bool "Axera SoCs"
	depends on ARCH_MULTI_V7
	select ARM_GIC
	select HAVE_ARM_ARCH_TIMER
	help
	  Support for the Axera AX620E family (AX620Q, AX630C). These SoCs
	  have Cortex-A53 cores that the vendor boot firmware starts in
	  AArch32, a GIC-400 and the Arm architected timer, and are used in
	  boards such as the Sipeed NanoKVM-Go.
```

## drivers/clk/axera/Kconfig
```kconfig
# SPDX-License-Identifier: GPL-2.0-only

config CLK_AX620E_GLB
	tristate "Axera AX620E clock and reset controllers"
	depends on ARCH_AXERA || COMPILE_TEST
	depends on OF
	default ARCH_AXERA
	select RESET_CONTROLLER
	help
	  Clock gates, source muxes, dividers and resets of the Axera
	  AX620E subsystem blocks: USB and SD/SDIO (FLASH_SYS), the video
	  codecs (VPU_SYS) and the low-speed peripherals such as GPIO and
	  I2C (PERIPH_SYS).
```

## drivers/media/platform/axera/Kconfig
```kconfig
# SPDX-License-Identifier: GPL-2.0-only

comment "Axera media platform drivers"

config VIDEO_AX620E_VIN
	tristate "Axera AX620E video input"
	depends on ARCH_AXERA || COMPILE_TEST
	depends on V4L_PLATFORM_DRIVERS
	depends on VIDEO_DEV
	depends on OF
	select MFD_SYSCON
	select V4L2_FWNODE
	select VIDEOBUF2_DMA_CONTIG
	help
	  Capture driver for the MIPI CSI-2 receiver and ISP front end of
	  the Axera AX620E SoCs, in YUV bypass mode (HDMI/DP to CSI-2
	  bridges such as the Lontium LT7911EXC).

	  To compile this driver as a module, choose M here: the module
	  will be called ax620e-vin.
```

## drivers/net/wireless/aicsemi/Kconfig
```kconfig
# SPDX-License-Identifier: GPL-2.0-only
config WLAN_VENDOR_AICSEMI
	bool "AICSemi devices"
	default y
	help
	  If you have a wireless card belonging to this class, say Y.

if WLAN_VENDOR_AICSEMI

config AIC8800
	tristate "AICSemi AIC8800 SDIO Wi-Fi"
	depends on CFG80211 && MMC && m
	help
	  Vendor driver for the AICSemi AIC8800 family (AIC8800D80) on
	  SDIO, ported from the Sipeed AX620E SDK. Builds the aic8800_bsp
	  and aic8800_fdrv modules; firmware is read from the directory
	  given by the aic8800_bsp aic_fw_path parameter.

endif
```
