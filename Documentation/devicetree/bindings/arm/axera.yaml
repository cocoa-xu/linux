## Documentation/devicetree/bindings/arm/axera.yaml
```yaml
# SPDX-License-Identifier: (GPL-2.0-only OR BSD-2-Clause)
%YAML 1.2
---
$id: http://devicetree.org/schemas/arm/axera.yaml#
$schema: http://devicetree.org/meta-schemas/core.yaml#

title: Axera platforms

maintainers:
  - Cocoa <i@uwucocoa.moe>

properties:
  $nodename:
    const: '/'
  compatible:
    oneOf:
      - description: AX620QE based boards
        items:
          - enum:
              - sipeed,nanokvm-go
          - const: axera,ax620qe

additionalProperties: true

...
```

## Documentation/devicetree/bindings/clock/axera,ax620e-comm-glb.yaml
```yaml
# SPDX-License-Identifier: (GPL-2.0-only OR BSD-2-Clause)
%YAML 1.2
---
$id: http://devicetree.org/schemas/clock/axera,ax620e-comm-glb.yaml#
$schema: http://devicetree.org/meta-schemas/core.yaml#

title: Axera AX620E common system controller

maintainers:
  - Cocoa <i@uwucocoa.moe>

description:
  Registers shared by several blocks of Axera AX620E SoCs, such as the
  D-PHY power control, which other drivers reach as a syscon, and the clock
  gates and resets of the always-on blocks, such as the temperature sensor.
  Indices are defined in include/dt-bindings/clock/axera,ax620e-comm-glb.h
  and include/dt-bindings/reset/axera,ax620e-comm-glb.h.

properties:
  compatible:
    items:
      - const: axera,ax620e-comm-glb
      - const: syscon

  reg:
    maxItems: 1

  clocks:
    items:
      - description: CPLL 24 MHz output
      - description: Peripheral APB clock

  clock-names:
    items:
      - const: cpll_24m
      - const: pclk_top

  '#clock-cells':
    const: 1

  '#reset-cells':
    const: 1

required:
  - compatible
  - reg
  - clocks
  - clock-names
  - '#clock-cells'
  - '#reset-cells'

additionalProperties: false

examples:
  - |
    syscon@2340000 {
        compatible = "axera,ax620e-comm-glb", "syscon";
        reg = <0x02340000 0x1000>;
        clocks = <&cpll_24m>, <&pclk_top>;
        clock-names = "cpll_24m", "pclk_top";
        #clock-cells = <1>;
        #reset-cells = <1>;
    };
```

## Documentation/devicetree/bindings/clock/axera,ax620e-flash-sys.yaml
```yaml
# SPDX-License-Identifier: (GPL-2.0-only OR BSD-2-Clause)
%YAML 1.2
---
$id: http://devicetree.org/schemas/clock/axera,ax620e-flash-sys.yaml#
$schema: http://devicetree.org/meta-schemas/core.yaml#

title: Axera AX620E FLASH_SYS clock and reset controller

maintainers:
  - Cocoa <i@uwucocoa.moe>

description:
  Clocks and resets of the USB 2.0 controller and the SD/SDIO hosts on
  Axera AX620E SoCs. The block also holds the USB VBUS-valid override, which
  the USB PHY reaches through the axera,flash-sys phandle. Indices are
  defined in include/dt-bindings/clock/axera,ax620e-flash-sys.h and
  include/dt-bindings/reset/axera,ax620e-flash-sys.h.

properties:
  compatible:
    const: axera,ax620e-flash-sys

  reg:
    maxItems: 1

  clocks:
    items:
      - description: CPLL 24 MHz output
      - description: EPLL 100 MHz output
      - description: CPLL 156 MHz output
      - description: CPLL 208 MHz output
      - description: EPLL 250 MHz output
      - description: CPLL 312 MHz output
      - description: NPLL 400 MHz output
      - description: Peripheral APB clock

  clock-names:
    items:
      - const: cpll_24m
      - const: epll_100m
      - const: cpll_156m
      - const: cpll_208m
      - const: epll_250m
      - const: cpll_312m
      - const: npll_400m
      - const: pclk_top

  '#clock-cells':
    const: 1

  '#reset-cells':
    const: 1

required:
  - compatible
  - reg
  - clocks
  - clock-names
  - '#clock-cells'
  - '#reset-cells'

additionalProperties: false

examples:
  - |
    clock-controller@10030000 {
        compatible = "axera,ax620e-flash-sys";
        reg = <0x10030000 0x9000>;
        clocks = <&cpll_24m>, <&epll_100m>, <&cpll_156m>, <&cpll_208m>,
                 <&epll_250m>, <&cpll_312m>, <&npll_400m>, <&pclk_top>;
        clock-names = "cpll_24m", "epll_100m", "cpll_156m", "cpll_208m",
                      "epll_250m", "cpll_312m", "npll_400m", "pclk_top";
        #clock-cells = <1>;
        #reset-cells = <1>;
    };
```

## Documentation/devicetree/bindings/clock/axera,ax620e-periph-sys.yaml
```yaml
# SPDX-License-Identifier: (GPL-2.0-only OR BSD-2-Clause)
%YAML 1.2
---
$id: http://devicetree.org/schemas/clock/axera,ax620e-periph-sys.yaml#
$schema: http://devicetree.org/meta-schemas/core.yaml#

title: Axera AX620E peripheral clock and reset controller

maintainers:
  - Cocoa <i@uwucocoa.moe>

description:
  Clock gates, source muxes and resets of the low-speed peripherals (GPIO,
  I2C, I2S, DMA) on Axera AX620E SoCs, the routing of the I2S controllers
  and of the peripheral DMA requests, which the DMA controller reaches as
  a syscon.
  Indices are defined in
  include/dt-bindings/clock/axera,ax620e-periph-sys.h and
  include/dt-bindings/reset/axera,ax620e-periph-sys.h.

properties:
  compatible:
    items:
      - const: axera,ax620e-periph-sys
      - const: syscon

  reg:
    maxItems: 1

  clocks:
    items:
      - description: 32.768 kHz RTC clock
      - description: CPLL 24 MHz output
      - description: EPLL 50 MHz output
      - description: CPLL 156 MHz output
      - description: CPLL 208 MHz output
      - description: Peripheral APB clock
      - description: HPLL 12.288 MHz output, the audio reference

  clock-names:
    items:
      - const: rtc_32k
      - const: cpll_24m
      - const: epll_50m
      - const: cpll_156m
      - const: cpll_208m
      - const: pclk_top
      - const: hpll_12m288

  '#clock-cells':
    const: 1

  '#reset-cells':
    const: 1

  axera,audio-routing:
    $ref: /schemas/types.yaml#/definitions/uint32
    description:
      Value of the audio routing register, which connects the I2S
      controllers to pads, to each other and to the internal codec. It
      depends on how the board is wired.

required:
  - compatible
  - reg
  - clocks
  - clock-names
  - '#clock-cells'
  - '#reset-cells'

additionalProperties: false

examples:
  - |
    clock-controller@4870000 {
        compatible = "axera,ax620e-periph-sys", "syscon";
        reg = <0x04870000 0x1000>;
        clocks = <&rtc_32k>, <&cpll_24m>, <&epll_50m>,
                 <&cpll_156m>, <&cpll_208m>, <&pclk_top>,
                 <&hpll_12m288>;
        clock-names = "rtc_32k", "cpll_24m", "epll_50m",
                      "cpll_156m", "cpll_208m", "pclk_top",
                      "hpll_12m288";
        #clock-cells = <1>;
        #reset-cells = <1>;
    };
```

## Documentation/devicetree/bindings/clock/axera,ax620e-vpu-sys.yaml
```yaml
# SPDX-License-Identifier: (GPL-2.0-only OR BSD-2-Clause)
%YAML 1.2
---
$id: http://devicetree.org/schemas/clock/axera,ax620e-vpu-sys.yaml#
$schema: http://devicetree.org/meta-schemas/core.yaml#

title: Axera AX620E VPU clock and reset controller

maintainers:
  - Cocoa <i@uwucocoa.moe>

description:
  Clock source muxes, clock gates and resets of the video codecs (JPEG
  encoder, H.264/H.265 encoder and decoder) on Axera AX620E SoCs. Clock and
  reset indices are defined in
  include/dt-bindings/clock/axera,ax620e-vpu-sys.h and
  include/dt-bindings/reset/axera,ax620e-vpu-sys.h.

properties:
  compatible:
    const: axera,ax620e-vpu-sys

  reg:
    maxItems: 1

  clocks:
    items:
      - description: CPLL 208 MHz output
      - description: CPLL 312 MHz output
      - description: EPLL 375 MHz output
      - description: CPLL 416 MHz output
      - description: EPLL 500 MHz output
      - description: NPLL 533 MHz output

  clock-names:
    items:
      - const: cpll_208m
      - const: cpll_312m
      - const: epll_375m
      - const: cpll_416m
      - const: epll_500m
      - const: npll_533m

  '#clock-cells':
    const: 1

  '#reset-cells':
    const: 1

required:
  - compatible
  - reg
  - clocks
  - clock-names
  - '#clock-cells'
  - '#reset-cells'

additionalProperties: false

examples:
  - |
    clock-controller@4030000 {
        compatible = "axera,ax620e-vpu-sys";
        reg = <0x04030000 0x1000>;
        clocks = <&cpll_208m>, <&cpll_312m>, <&epll_375m>,
                 <&cpll_416m>, <&epll_500m>, <&npll_533m>;
        clock-names = "cpll_208m", "cpll_312m", "epll_375m",
                      "cpll_416m", "epll_500m", "npll_533m";
        #clock-cells = <1>;
        #reset-cells = <1>;
    };
```

## Documentation/devicetree/bindings/dma/axera,ax620e-pdma.yaml
```yaml
# SPDX-License-Identifier: (GPL-2.0-only OR BSD-2-Clause)
%YAML 1.2
---
$id: http://devicetree.org/schemas/dma/axera,ax620e-pdma.yaml#
$schema: http://devicetree.org/meta-schemas/core.yaml#

title: Axera AX620E peripheral DMA controller

maintainers:
  - Cocoa <i@uwucocoa.moe>

description:
  The DMA controller of the low-speed peripherals (I2S, SPI, UART) on Axera
  AX620E SoCs. Its sixteen channels walk lists of descriptors in memory;
  the peripheral request that paces a channel is selected in the
  peripheral system controller. The specifier cell is that request.

allOf:
  - $ref: dma-controller.yaml#

properties:
  compatible:
    const: axera,ax620e-pdma

  reg:
    maxItems: 1

  interrupts:
    maxItems: 1

  clocks:
    items:
      - description: AXI clock
      - description: APB clock

  resets:
    items:
      - description: AXI reset
      - description: APB reset

  reset-names:
    items:
      - const: axi
      - const: apb

  axera,periph-sys:
    $ref: /schemas/types.yaml#/definitions/phandle
    description:
      The peripheral system controller, which routes the peripheral
      requests to the channels.

  dma-channels:
    const: 16

  '#dma-cells':
    const: 1

required:
  - compatible
  - reg
  - interrupts
  - clocks
  - resets
  - reset-names
  - axera,periph-sys
  - '#dma-cells'

unevaluatedProperties: false

examples:
  - |
    #include <dt-bindings/clock/axera,ax620e-periph-sys.h>
    #include <dt-bindings/interrupt-controller/arm-gic.h>
    #include <dt-bindings/reset/axera,ax620e-periph-sys.h>

    dma-controller@48a0000 {
        compatible = "axera,ax620e-pdma";
        reg = <0x048a0000 0x1000>;
        interrupts = <GIC_SPI 112 IRQ_TYPE_LEVEL_HIGH>;
        clocks = <&periph_sys AX620E_PERIPH_ACLK_DMA>,
                 <&periph_sys AX620E_PERIPH_PCLK_DMA>;
        resets = <&periph_sys AX620E_PERIPH_RST_DMA_AXI>,
                 <&periph_sys AX620E_PERIPH_RST_DMA_APB>;
        reset-names = "axi", "apb";
        axera,periph-sys = <&periph_sys>;
        dma-channels = <16>;
        #dma-cells = <1>;
    };
```

## Documentation/devicetree/bindings/gpio/axera,ax620e-gpio.yaml
```yaml
# SPDX-License-Identifier: (GPL-2.0-only OR BSD-2-Clause)
%YAML 1.2
---
$id: http://devicetree.org/schemas/gpio/axera,ax620e-gpio.yaml#
$schema: http://devicetree.org/meta-schemas/core.yaml#

title: Axera AX620E GPIO controller

maintainers:
  - Cocoa <i@uwucocoa.moe>

description:
  Bank of 32 GPIO lines with one control register per line and one
  interrupt output for the bank.

properties:
  compatible:
    const: axera,ax620e-gpio

  reg:
    maxItems: 1

  interrupts:
    maxItems: 1

  clocks:
    items:
      - description: Debounce clock
      - description: APB clock

  resets:
    maxItems: 1

  gpio-controller: true

  '#gpio-cells':
    const: 2

  interrupt-controller: true

  '#interrupt-cells':
    const: 2

required:
  - compatible
  - reg
  - clocks
  - gpio-controller
  - '#gpio-cells'

additionalProperties: false

examples:
  - |
    #include <dt-bindings/clock/axera,ax620e-periph-sys.h>
    #include <dt-bindings/interrupt-controller/arm-gic.h>
    #include <dt-bindings/reset/axera,ax620e-periph-sys.h>

    gpio@4801000 {
        compatible = "axera,ax620e-gpio";
        reg = <0x04801000 0x400>;
        interrupts = <GIC_SPI 115 IRQ_TYPE_LEVEL_HIGH>;
        clocks = <&periph_sys AX620E_PERIPH_CLK_GPIO1>,
                 <&periph_sys AX620E_PERIPH_PCLK_GPIO1>;
        resets = <&periph_sys AX620E_PERIPH_RST_GPIO1>;
        gpio-controller;
        #gpio-cells = <2>;
        interrupt-controller;
        #interrupt-cells = <2>;
    };
```

## Documentation/devicetree/bindings/media/axera,ax620e-jenc.yaml
```yaml
# SPDX-License-Identifier: (GPL-2.0-only OR BSD-2-Clause)
%YAML 1.2
---
$id: http://devicetree.org/schemas/media/axera,ax620e-jenc.yaml#
$schema: http://devicetree.org/meta-schemas/core.yaml#

title: Axera AX620E JPEG and video encoders

maintainers:
  - Cocoa <i@uwucocoa.moe>

description:
  VeriSilicon VC8000E encoder cores, one in JPEG-only configuration and one
  for H.264 and HEVC, each with its registers behind a VCMD command parser.

properties:
  compatible:
    enum:
      - axera,ax620e-jenc
      - axera,ax620e-venc

  reg:
    maxItems: 1

  interrupts:
    maxItems: 1

  clocks:
    maxItems: 1

  resets:
    maxItems: 1

required:
  - compatible
  - reg
  - interrupts
  - clocks

additionalProperties: false

examples:
  - |
    #include <dt-bindings/clock/axera,ax620e-vpu-sys.h>
    #include <dt-bindings/interrupt-controller/arm-gic.h>
    #include <dt-bindings/reset/axera,ax620e-vpu-sys.h>

    jpeg-encoder@4000000 {
        compatible = "axera,ax620e-jenc";
        reg = <0x04000000 0x10000>;
        interrupts = <GIC_SPI 91 IRQ_TYPE_LEVEL_HIGH>;
        clocks = <&vpu_sys AX620E_VPU_CLK_JENC>;
        resets = <&vpu_sys AX620E_VPU_RST_JENC>;
    };
```

## Documentation/devicetree/bindings/media/axera,ax620e-vin.yaml
```yaml
# SPDX-License-Identifier: (GPL-2.0-only OR BSD-2-Clause)
%YAML 1.2
---
$id: http://devicetree.org/schemas/media/axera,ax620e-vin.yaml#
$schema: http://devicetree.org/meta-schemas/core.yaml#

title: Axera AX620E video input

maintainers:
  - Cocoa <i@uwucocoa.moe>

description:
  MIPI D-PHY receiver, CSI-2 controller and ISP front end of the Axera
  AX620E SoCs, used in YUV bypass mode to write received frames to memory.

properties:
  compatible:
    const: axera,ax620e-vin

  reg:
    items:
      - description: ISP registers, including the front end and its write DMA
      - description: ISP subsystem clock and reset registers
      - description: CSI-2 controller 0
      - description: MIPI D-PHY receiver

  reg-names:
    items:
      - const: isp
      - const: glb
      - const: csi
      - const: dphy

  interrupts:
    maxItems: 1

  axera,comm-glb:
    $ref: /schemas/types.yaml#/definitions/phandle
    description: COMM_GLB syscon holding the D-PHY power and TLB clock bits.

  port:
    $ref: /schemas/graph.yaml#/$defs/port-base
    unevaluatedProperties: false

    properties:
      endpoint:
        $ref: video-interfaces.yaml#
        unevaluatedProperties: false

        properties:
          data-lanes:
            items:
              - const: 1
              - const: 2
              - const: 3
              - const: 4

        required:
          - data-lanes

required:
  - compatible
  - reg
  - reg-names
  - interrupts
  - axera,comm-glb

additionalProperties: false

examples:
  - |
    #include <dt-bindings/interrupt-controller/arm-gic.h>

    video-capture@2400000 {
        compatible = "axera,ax620e-vin";
        reg = <0x02400000 0x100000>,
              <0x02500000 0x1000>,
              <0x02600000 0x1000>,
              <0x023f0000 0x1000>;
        reg-names = "isp", "glb", "csi", "dphy";
        interrupts = <GIC_SPI 27 IRQ_TYPE_LEVEL_HIGH>;
        axera,comm-glb = <&comm_glb>;

        port {
            vin_in: endpoint {
                remote-endpoint = <&bridge_out>;
                data-lanes = <1 2 3 4>;
            };
        };
    };
```
